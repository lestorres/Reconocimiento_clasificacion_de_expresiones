## yocto/conf/bblayers.conf
```bitbake
# POKY_BBLAYERS_CONF_VERSION is increased each time build/conf/bblayers.conf
# changes incompatibly
POKY_BBLAYERS_CONF_VERSION = "2"

BBPATH = "${TOPDIR}"
BBFILES ?= ""

BBLAYERS ?= " \
  /home/lesme/yocto-rpi5/poky/meta \
  /home/lesme/yocto-rpi5/poky/meta-poky \
  /home/lesme/yocto-rpi5/poky/meta-yocto-bsp \
  /home/lesme/yocto-rpi5/meta-raspberrypi \
  /home/lesme/yocto-rpi5/meta-openembedded/meta-oe \
  /home/lesme/yocto-rpi5/meta-openembedded/meta-python \
  /home/lesme/yocto-rpi5/meta-openembedded/meta-networking \
  /home/lesme/yocto-rpi5/meta-openembedded/meta-multimedia \
  /home/lesme/yocto-rpi5/meta-tensorflow \
  /home/lesme/yocto-rpi5/meta-mylayer \
  "
```
